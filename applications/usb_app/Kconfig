## applications/usb_app/Kconfig
```kconfig
config  RT_USING_HIDTEST
    bool "enable usb hid test app"
    default n
    depends on RT_USING_USBAPP
    help
         hid app test
```

## bsp/rockchip/common/drivers/audio/codecs/Kconfig
```kconfig
config RT_USING_CODEC
    bool
    default n

    config RT_USING_ACDCDIG
        depends on RT_USING_CODEC
        bool

    config RT_USING_ACODEC
        depends on RT_USING_CODEC
        bool

    config RT_USING_CODEC_AW8896
        depends on RT_USING_CODEC
        bool

    config RT_USING_CODEC_ES7243
        depends on RT_USING_CODEC
        bool

    config RT_USING_CODEC_ES8156
        depends on RT_USING_CODEC
        bool

    config RT_USING_CODEC_ES8311
        depends on RT_USING_CODEC
        bool

    config RT_USING_CODEC_ES8388
        depends on RT_USING_CODEC
        bool

    config RT_USING_CODEC_NAU88L25B
        depends on RT_USING_CODEC
        bool

    config RT_USING_I2STDM
        depends on RT_USING_CODEC
        bool

    config RT_USING_I2STDM1
        depends on RT_USING_CODEC
        bool
        
```

## components/system/LittlevGL2RTT/Kconfig
```kconfig
# Kconfig file for LVGL v8.0

menuconfig RT_USING_LITTLEVGL2RTT
    bool "LittlevGL2RTT: The LittlevGl release v8.3.0 gui lib adapter RT-Thread"
    default n
    depends on !PKG_USING_LITTLEVGL2RTT
```
